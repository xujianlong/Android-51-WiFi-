/************************************************************************
*                                                                 	*
* TX-51STAR单片机开发系统演示程序 - 串行通迅                      	*
*                                                                 	*
* LCD1602显示                                                     	*
*                                                                 	*
* 工作芯片：STC89C516      晶振频率：11.0592MHz                   	*
*                                                                 	*
* 版本： V1.0 (2009/1/2)                                          	*
* 作者： 郭天祥 (Email: txmcu@163.com)                            	*
* 网站： www.tx-power.com(天祥电子)                               	*
* 邮箱： txmcu@163.com                                           	*
*                                                                 	*
*【版权】Copyright(C)天祥电子 www.tx-power.com  All Rights Reserved     *
*【声明】此程序仅用于学习与参考，引用请注明版权和作者信息！             *
*                                                                 	*
*************************************************************************
*                                                                 	*
* 描述：                                                          	*
*                                                                 	*
*   主机发送123456给单片机，单片机接收到数据后发送TX-MCU给主机。  	*
*                                                                 	*
*   主机发送其它数据给单片机，单片机接收到数据后，再发送给主机。  	*
*                                                                 	*
*   LCD1602显示接收数据的ASCII码。  波特率9600          		*
*									*
*   注：当单片机收到数据只有凑够16个时才会一次在液晶上显示出来		*
*                                                                 	*
************************************************************************/

#include <reg52.h>
#include <intrins.h>
#include <stdio.h>

#define uchar  unsigned char
#define uint   unsigned int

sbit LCD_RS = P3^5;
sbit LCD_EN = P3^4;

#define delayNOP(); {_nop_();_nop_();_nop_();_nop_();};


uchar data  RXDdata[ ] = {0x20,0x20,0x20,0x20,0x20,0x20,0x20,0x20,
                          0x20,0x20,0x20,0x20,0x20,0x20,0x20,0x20
                         };
uchar temp,buf,m,count;

bit   playflag=0;

uchar code  cdis1[ ] = {" SERILA TRANFER "};
uchar code  cdis2[ ] = {"                "};

uchar flag,i;
/**********************************************************

 延时子程序

**********************************************************/
void delay(uint ms)

{
	uchar k;
	while(ms--)
		{
			for(k = 0; k < 120; k++);
		}
}


/*********************************************************

  串行中断服务函数

*********************************************************/
void  serial() interrupt 4
{
	ES = 0;                //关闭串行中断
	RI = 0;                //清除串行接受标志位
	buf = SBUF;            //从串口缓冲区取得数据

//   if(buf!=0x0D)
	{
//     if(buf!=0x0A)
		{
			temp =buf;
			if(count<4)
				{
					RXDdata[count]=temp;
					count++;
				}
		}
	}
	ES = 1;    //允许串口中断
	flag=1;
}


/*********************************************************

  主函数

*********************************************************/
void main(void)
{

	SCON=0x50;           //设定串口工作方式
	PCON=0x00;           //波特率不倍增

	TMOD=0x20;           //定时器1工作于8位自动重载模式, 用于产生波特率
	EA=1;
	ES = 1;              //允许串口中断
	TL1=0xfd;
	TH1=0xfd;             //波特率9600
	TR1=1;
	TI=1;//直接使用printf必须加入此句才能实现发送

	while(1)
		{
			printf("51printf\n");
//      delay(100);
		}
}

/*********************************************************/
